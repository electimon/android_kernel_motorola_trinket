## drivers/input/touchscreen/focaltech_0flash_mmi/Kconfig
```kconfig
#
# Focaltech Touchscreen driver configuration
#

config TOUCHSCREEN_FTS_0FLASH_MMI
	tristate "Moto Focaltech Touchscreen"
	depends on I2C
	default n
	help
	  Say Y here if you have Moto Focaltech touch panel.
	  If unsure, say N.

config TOUCHSCREEN_FTS_0FLASH_MMI_ENABLE_DOUBLE_TAP
	bool "Moto Focaltech Double tap"
	depends on TOUCHSCREEN_FTS_0FLASH_MMI
	default n
	help
	  Say Y here to enable support for double tap functionality on Focaltech touch panel.
	  If unsure, say N.

config TOUCHSCREEN_FTS_0FLASH_MMI_ENABLE_PALM
	bool "Moto Focaltech Palm"
	depends on TOUCHSCREEN_FTS_0FLASH_MMI
	default n
	help
	  Say Y here to enable support for Palm functionality on Focaltech touch panel.
	  If unsure, say N.
```
